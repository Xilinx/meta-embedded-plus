## conf/machine/include/emb-plus-ve2302-amr/emb-plus-ve2302-amr-cortexr5-0-freertos-features.conf
```bitbake
MACHINE_FEATURES = "cframe cfupmc clk-wiz common coresightps-dcc csudma gpio gpiops iicps ipipsu ospipsv rtcpsu scugic spips sysmonpsv trngpsv ttcps uartlite uartpsv zdma"
```

## conf/machine/include/emb-plus-ve2302-xrt/emb-plus-ve2302-xrt-microblaze-pmc-features.conf
```bitbake
MACHINE_FEATURES = "cframe cfupmc common csudma gpiops iicps iomodule ipipsu ospipsv sysmonpsv trngpsv ttcps uartlite uartpsv zdma"
```
