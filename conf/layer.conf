## conf/machine/emb-plus-ve2302.conf
```bitbake
#@TYPE: Machine
#@NAME: emb-plus-ve2302
#@DESCRIPTION: Machine configuration for the emb-plus-ve2302 boards.

#### Preamble
MACHINEOVERRIDES =. "${@['', 'emb-plus-ve2302:']['emb-plus-ve2302' !='${MACHINE}']}"
#### Regular settings follow

# Yocto device-tree variables
YAML_CONSOLE_DEVICE_CONFIG:pn-device-tree ?= "blp_cips_pspmc_0_psv_sbsauart_1"
YAML_MAIN_MEMORY_CONFIG:pn-device-tree ?= "C0_DDR_LOW0"
DT_PADDING_SIZE:pn-device-tree ?= "0x1000"
DTC_FLAGS:pn-device-tree ?= ""
YAML_DT_BOARD_FLAGS ?= "{BOARD versal-emb-plus-ve2302-reva}"

# Yocto u-boot-xlnx variables
UBOOT_MACHINE ?= "xilinx_versal_virt_defconfig"

# Yocto PLM variables
YAML_SERIAL_CONSOLE_STDIN:pn-plm-firmware ?= "blp_cips_pspmc_0_psv_sbsauart_0"
YAML_SERIAL_CONSOLE_STDOUT:pn-plm-firmware ?= "blp_cips_pspmc_0_psv_sbsauart_0"

# Serial Console Settings
SERIAL_CONSOLES ?= "115200;ttyAMA0"
YAML_SERIAL_CONSOLE_BAUDRATE ?= "115200"

# Yocto arm-trusted-firmware(TF-A) variables
ATF_CONSOLE ?= "pl011_1"
TFA_BL33_LOAD ?= "0x8000000"

# Set DDR Base address for u-boot-xlnx-scr variables
DDR_BASEADDR ?= "0x0"
SKIP_APPEND_BASEADDR ?= "0"

# Yocto KERNEL Variables
UBOOT_ENTRYPOINT  ?= "0x200000"
UBOOT_LOADADDRESS ?= "0x200000"

# Required generic machine inclusion
require conf/machine/versal-generic.conf

# This is an 'XSCT' based BSP
XILINX_XSCT_VERSION = "2024.2"
XILINX_WITH_ESW = "xsct"

# Add system XSA
HDF_URI = "https://petalinux.xilinx.com/sswreleases/rel-v2024.2/hdf-examples/2024.2/2024.2_1104_1_11050118/external/embedded-plus-ve2302/embedded-plus-ve2302-2024.2_1104_1.xsa"
HDF_URI[sha256sum] = "3142672324245f787d2884941b63461db434aafe076ca4ded04358ea31486b4e"

#### No additional settings should be after the Postamble
#### Postamble
PACKAGE_EXTRA_ARCHS:append = "${@['', ' emb_plus_ve2302']['emb-plus-ve2302' != '${MACHINE}']}"
```

## conf/machine/include/emb-plus-ve2302-amr/emb-plus-ve2302-amr-microblaze-pmc-features.conf
```bitbake
MACHINE_FEATURES = "cframe cfupmc common csudma gpiops iicps iomodule ipipsu ospipsv spips sysmonpsv trngpsv ttcps uartlite uartpsv zdma"
```

## conf/machine/versal-rave.conf
```bitbake
#@TYPE: Machine
#@NAME: versal-rave
#@DESCRIPTION: Machine configuration for the RAVE evaluation boards.

#### Preamble
MACHINEOVERRIDES =. "${@['', 'versal-rave:']['versal-rave' !='${MACHINE}']}"
#### Regular settings follow

# Yocto device-tree variables
YAML_CONSOLE_DEVICE_CONFIG:pn-device-tree ?= "blp_cips_pspmc_0_psv_sbsauart_0"
YAML_MAIN_MEMORY_CONFIG:pn-device-tree ?= "C0_DDR_LOW0"
#YAML_DT_BOARD_FLAGS ?= "{BOARD versal-rave-reva}"
YAML_DT_BOARD_FLAGS ?= "{BOARD template}"

# PLM variables
YAML_SERIAL_CONSOLE_STDIN:pn-plm-firmware ?= "blp_cips_pspmc_0_psv_sbsauart_0"
YAML_SERIAL_CONSOLE_STDOUT:pn-plm-firmware ?= "blp_cips_pspmc_0_psv_sbsauart_0"

# Set DDR Base address for u-boot-xlnx-scr variables
DDR_BASEADDR ?= "0x00000000"
SKIP_APPEND_BASEADDR ?= "0"

# Required generic machine inclusion
require conf/machine/versal-ai-edge-generic.conf

HDF_MACHINE = "rave-ve2302"

#### No additional settings should be after the Postamble
#### Postamble
PACKAGE_EXTRA_ARCHS:append = "${@['', ' versal-rave']['versal-rave' != '${MACHINE}']}"
```
