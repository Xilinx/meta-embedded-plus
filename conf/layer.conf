## conf/layer.conf
```bitbake
# We have a conf and classes directory, add to BBPATH
BBPATH .= ":${LAYERDIR}"

# We have a packages directory, add to BBFILES
BBFILES += " \
    ${LAYERDIR}/recipes-*/*/*.bb \
    ${LAYERDIR}/recipes-*/*/*.bbappend \
    "

BBFILE_COLLECTIONS += "rave"
BBFILE_PRIORITY_rave = "5"
BBFILE_PATTERN_rave = "^${LAYERDIR}/"
BBFILE_PATTERN_IGNORE_EMPTY_rave = "1"

LAYERDEPENDS_rave  = "core xilinx"

LAYERRECOMMENDS_rave = "xilinx-tools"

LAYERSERIES_COMPAT_rave = "langdale"

LAYER_PATH_rave-layer = "${LAYERDIR}"
```

## conf/machine/alveo-v80-amr.conf
```bitbake
#@TYPE: Machine
#@NAME: alveo-v80-amr
#@DESCRIPTION: AMP/multidomain machine for the AMD Alveo V80 Compute Accelerator Card (Versal Premium) running the AMR (AVED Management Runtime) stack: Cortex-A72 Linux plus Cortex-R5 FreeRTOS and MicroBlaze PMC/PSM sub-machines.

BBMULTICONFIG += "alveo-v80-amr-microblaze-pmc alveo-v80-amr-microblaze-psm alveo-v80-amr-cortexr5-0-freertos"
MACHINEOVERRIDES .= ":alveo-amr"

#### Preamble
MACHINEOVERRIDES =. "${@['', 'alveo-v80-amr:']['alveo-v80-amr' !='${MACHINE}']}"
#### Regular settings follow
TUNEFILE[microblaze-pmc] = "conf/machine/include/alveo-v80-amr/microblaze.inc"
TUNEFILE[microblaze-psm] = "conf/machine/include/alveo-v80-amr/microblaze.inc"

# Platform Loader and Manager
PLM_DEPENDS = ""
PLM_MCDEPENDS = "mc::alveo-v80-amr-microblaze-pmc:plm-firmware:do_deploy"
PLM_DEPLOY_DIR = "${TMPDIR}-alveo-v80-amr-microblaze-pmc/deploy/images/${MACHINE}"

# PSM Firmware
PSM_DEPENDS = ""
PSM_MCDEPENDS = "mc::alveo-v80-amr-microblaze-psm:psm-firmware:do_deploy"
PSM_FIRMWARE_DEPLOY_DIR = "${TMPDIR}-alveo-v80-amr-microblaze-psm/deploy/images/${MACHINE}"

# Set the default (linux) domain device tree
CONFIG_DTFILE_DIR := "${@bb.utils.which(d.getVar('BBPATH'), 'conf/dts/alveo-v80-amr')}"
CONFIG_DTFILE ?= "${CONFIG_DTFILE_DIR}/cortexa72-linux.dts"
CONFIG_DTFILE[vardepsexclude] += "CONFIG_DTFILE_DIR"

DTB_FILE_PATH ?= "${RECIPE_SYSROOT}/boot/devicetree/${@os.path.basename(d.getVar('CONFIG_DTFILE').replace('.dts', '.dtb'))}"

# Serial Console Settings
SERIAL_CONSOLES ?= "115200;ttyAMA1"

# Yocto arm-trusted-firmware(TF-A) variables
TFA_CONSOLE ?= "pl011_1"
TFA_BL33_LOAD ?= "0x8000000"

# Yocto u-boot-xlnx variables

# Set DDR Base address for u-boot-xlnx-scr variables
DDR_BASEADDR ?= "0x0"
SKIP_APPEND_BASEADDR ?= "0"

# Yocto KERNEL Variables
UBOOT_ENTRYPOINT ?= "0x200000"
UBOOT_LOADADDRESS ?= "0x200000"

# Yocto MACHINE_FEATURES Variable
MACHINE_FEATURES += "fpga-overlay efi"

# Required generic machine inclusion
require conf/machine/versal-generic.conf

# QEMU Memory Configuration
QB_MEM = "-machine dynamic-mem=on -device amd-ddr-memory,address=0x4000000000,size=0x800000000 -device amd-ddr-memory,address=0x20100000000,size=0x800000 -device amd-ddr-memory,address=0x50080000000,size=0x80000000 -device amd-ddr-memory,address=0x60000000000,size=0x800000000"

# OSPI flash size (256MB)
SPI_IMAGE_SIZE = "0x1000_0000"
# Use the specific boot script
UBOOT_BOOT_SCRIPT:alveo-v80-amr:${DISTRO} = "u-boot-xlnx-scr"

# This is an 'SDT' based BSP
XILINX_WITH_ESW = "sdt"

# Original SDT artifacts URL
SDT_URI = "https://edf.amd.com/sswreleases/rel-v2026.1/sdt/2026.1/2026.1_0609_1_06092108/external/alveo-v80-amr/alveo-v80-amr_2026.1_0609_1_06092108.tar.gz"
SDT_URI[sha256sum] = "9b58d3bd95cb8585b19b2011f77cd8e32d81e44faf9d058ddff17d6d158c0c7a"
SDT_URI[S] = "${WORKDIR}/alveo-v80-amr_2026.1_0609_1_06092108"

# Set the system device trees
SYSTEM_DTFILE_DEPENDS = "sdt-artifacts"
SYSTEM_DTFILE_DIR = "${RECIPE_SYSROOT}${datadir}/sdt/${MACHINE}"
SYSTEM_DTFILE = "${SYSTEM_DTFILE_DIR}/system-top.dts"

# Load the dynamic machine features
include conf/machine/include/alveo-v80-amr/${BB_CURRENT_MC}-features.conf
LIBXIL_CONFIG = "conf/machine/include/alveo-v80-amr/${BB_CURRENT_MC}-libxil.conf"

# PDI variables
PDI_PATH_DEPENDS = "sdt-artifacts"
PDI_PATH_DIR = "${RECIPE_SYSROOT}${datadir}/sdt/${MACHINE}"
PDI_PATH = "${PDI_PATH_DIR}/v80_base_boot.pdi"

# Primary Bootmode value
DEFAULT_HW_BOOT_MODE = "8"

# Update bootbin to use proper device tree
BIF_PARTITION_IMAGE[device-tree] = "${DTB_FILE_PATH}"

# Remap boot files to ensure the right device tree is listed first
IMAGE_BOOT_FILES =+ "devicetree/${@os.path.basename(d.getVar('CONFIG_DTFILE').replace('.dts', '.dtb'))}"

#### No additional settings should be after the Postamble
#### Postamble
PACKAGE_EXTRA_ARCHS:append = "${@['', ' alveo_v80_amr']['alveo-v80-amr' != '${MACHINE}']}"
```

## conf/machine/emb-plus-ve2302-amr.conf
```bitbake
#@TYPE: Machine
#@NAME: emb-plus-ve2302-amr
#@DESCRIPTION: AMP/multidomain machine for the AMD Embedded+ VE2302 board (Versal AI Edge VE2302) running the AMR stack: Cortex-A72 Linux plus Cortex-R5 FreeRTOS/baremetal and MicroBlaze PMC/PSM sub-machines.

BBMULTICONFIG += "emb-plus-ve2302-amr-microblaze-pmc emb-plus-ve2302-amr-microblaze-psm emb-plus-ve2302-amr-cortexr5-0-freertos emb-plus-ve2302-amr-cortexr5-1-baremetal"
MACHINEOVERRIDES .= ":emb-plus-amr"

#### Preamble
MACHINEOVERRIDES =. "${@['', 'emb-plus-ve2302-amr:']['emb-plus-ve2302-amr' !='${MACHINE}']}"
#### Regular settings follow
TUNEFILE[microblaze-pmc] = "conf/machine/include/emb-plus-ve2302-amr/microblaze.inc"
TUNEFILE[microblaze-psm] = "conf/machine/include/emb-plus-ve2302-amr/microblaze.inc"

# Platform Loader and Manager
PLM_DEPENDS = ""
PLM_MCDEPENDS = "mc::emb-plus-ve2302-amr-microblaze-pmc:plm-firmware:do_deploy"
PLM_DEPLOY_DIR = "${TMPDIR}-emb-plus-ve2302-amr-microblaze-pmc/deploy/images/${MACHINE}"

# PSM Firmware
PSM_DEPENDS = ""
PSM_MCDEPENDS = "mc::emb-plus-ve2302-amr-microblaze-psm:psm-firmware:do_deploy"
PSM_FIRMWARE_DEPLOY_DIR = "${TMPDIR}-emb-plus-ve2302-amr-microblaze-psm/deploy/images/${MACHINE}"

# Set the default (linux) domain device tree
CONFIG_DTFILE_DIR := "${@bb.utils.which(d.getVar('BBPATH'), 'conf/dts/emb-plus-ve2302-amr')}"
CONFIG_DTFILE ?= "${CONFIG_DTFILE_DIR}/cortexa72-linux.dts"
CONFIG_DTFILE[vardepsexclude] += "CONFIG_DTFILE_DIR"

DTB_FILE_PATH ?= "${RECIPE_SYSROOT}/boot/devicetree/${@os.path.basename(d.getVar('CONFIG_DTFILE').replace('.dts', '.dtb'))}"

# Serial Console Settings
SERIAL_CONSOLES ?= "115200;ttyAMA1"

# Yocto arm-trusted-firmware(TF-A) variables
TFA_CONSOLE ?= "pl011_1"
TFA_BL33_LOAD ?= "0x8000000"

# Yocto u-boot-xlnx variables

# Set DDR Base address for u-boot-xlnx-scr variables
DDR_BASEADDR ?= "0x0"
SKIP_APPEND_BASEADDR ?= "0"

# Yocto KERNEL Variables
UBOOT_ENTRYPOINT ?= "0x8200000"
UBOOT_LOADADDRESS ?= "0x8200000"

# Yocto MACHINE_FEATURES Variable
MACHINE_FEATURES += "vdu fpga-overlay efi"

# Required generic machine inclusion
require conf/machine/versal-generic.conf

# QEMU Memory Configuration
QB_MEM = "-machine dynamic-mem=on -device amd-ddr-memory,address=0x50000000000,size=0x180000000"

# OSPI flash size (128MB)
SPI_IMAGE_SIZE = "0x0800_0000"
# Use the specific boot script
UBOOT_BOOT_SCRIPT:emb-plus-ve2302-amr:${DISTRO} = "u-boot-xlnx-scr"

# This is an 'SDT' based BSP
XILINX_WITH_ESW = "sdt"

# Original SDT artifacts URL
SDT_URI = "https://edf.amd.com/sswreleases/rel-v2026.1/sdt/2026.1/2026.1_0609_1_06092108/external/emb-plus-ve2302-amr/emb-plus-ve2302-amr_2026.1_0609_1_06092108.tar.gz"
SDT_URI[sha256sum] = "2c1aadd66d155e67685b17472ba513c5c263dea64db751800963aa5c62274e59"
SDT_URI[S] = "${WORKDIR}/emb-plus-ve2302-amr_2026.1_0609_1_06092108"

# Set the system device trees
SYSTEM_DTFILE_DEPENDS = "sdt-artifacts"
SYSTEM_DTFILE_DIR = "${RECIPE_SYSROOT}${datadir}/sdt/${MACHINE}"
SYSTEM_DTFILE = "${SYSTEM_DTFILE_DIR}/system-top.dts"

# Load the dynamic machine features
include conf/machine/include/emb-plus-ve2302-amr/${BB_CURRENT_MC}-features.conf
LIBXIL_CONFIG = "conf/machine/include/emb-plus-ve2302-amr/${BB_CURRENT_MC}-libxil.conf"

# PDI variables
PDI_PATH_DEPENDS = "sdt-artifacts"
PDI_PATH_DIR = "${RECIPE_SYSROOT}${datadir}/sdt/${MACHINE}"
PDI_PATH = "${PDI_PATH_DIR}/ve2302_xdma_base.pdi"

# Primary Bootmode value
DEFAULT_HW_BOOT_MODE = "5"

# Update bootbin to use proper device tree
BIF_PARTITION_IMAGE[device-tree] = "${DTB_FILE_PATH}"

# Remap boot files to ensure the right device tree is listed first
IMAGE_BOOT_FILES =+ "devicetree/${@os.path.basename(d.getVar('CONFIG_DTFILE').replace('.dts', '.dtb'))}"

#### No additional settings should be after the Postamble
#### Postamble
PACKAGE_EXTRA_ARCHS:append = "${@['', ' emb_plus_ve2302_amr']['emb-plus-ve2302-amr' != '${MACHINE}']}"
```

## conf/machine/emb-plus-ve2302-sdt.conf
```bitbake
#@TYPE: Machine
#@NAME: emb-plus-ve2302-sdt
#@DESCRIPTION: Machine configuration for the emb-plus-ve2302-sdt boards.

BBMULTICONFIG += "emb-plus-ve2302-sdt-microblaze-pmc emb-plus-ve2302-sdt-microblaze-psm"

#### Preamble
MACHINEOVERRIDES =. "${@['', 'emb-plus-ve2302-sdt:']['emb-plus-ve2302-sdt' !='${MACHINE}']}"
#### Regular settings follow
TUNEFILE[microblaze-pmc] = "conf/machine/include/emb-plus-ve2302-sdt/microblaze.inc"
TUNEFILE[microblaze-psm] = "conf/machine/include/emb-plus-ve2302-sdt/microblaze.inc"

# Platform Loader and Manager
PLM_DEPENDS = ""
PLM_MCDEPENDS = "mc::emb-plus-ve2302-sdt-microblaze-pmc:plm-firmware:do_deploy"
PLM_DEPLOY_DIR = "${TMPDIR}-emb-plus-ve2302-sdt-microblaze-pmc/deploy/images/${MACHINE}"

# PSM Firware
PSM_DEPENDS = ""
PSM_MCDEPENDS = "mc::emb-plus-ve2302-sdt-microblaze-psm:psm-firmware:do_deploy"
PSM_FIRMWARE_DEPLOY_DIR = "${TMPDIR}-emb-plus-ve2302-sdt-microblaze-psm/deploy/images/${MACHINE}"

# Set the default (linux) domain device tree
CONFIG_DTFILE_DIR := "${@bb.utils.which(d.getVar('BBPATH'), 'conf/dts/emb-plus-ve2302-sdt')}"
CONFIG_DTFILE ?= "${CONFIG_DTFILE_DIR}/cortexa72-linux.dts"
CONFIG_DTFILE[vardepsexclude] += "CONFIG_DTFILE_DIR"

# Yocto arm-trusted-firmware(TF-A) variables
ATF_CONSOLE ?= "pl011"
TFA_BL33_LOAD ?= "0x8000000"

# Set DDR Base address for u-boot-xlnx-scr variables
DDR_BASEADDR ?= "0x0"
SKIP_APPEND_BASEADDR ?= "0"

# Yocto KERNEL Variables
UBOOT_ENTRYPOINT  ?= "0x200000"
UBOOT_LOADADDRESS ?= "0x200000"

# Required generic machine inclusion
require conf/machine/versal-generic.conf

MACHINEOVERRIDES =. ":emb-plus-ve2302"

# This is an 'SDT' based BSP
XILINX_WITH_ESW = "sdt"

# Original SDT artifacts URL
SDT_URI = "https://petalinux.xilinx.com/sswreleases/rel-v2024.2/sdt/2024.2/2024.2_1106_1_11061206/external/emb-plus-ve2302-sdt/emb-plus-ve2302-sdt_2024.2_1105_1.tar.gz"
SDT_URI[sha256sum] = "c8bffadea811c0aad2c05d807d5f2dc21b61d4b067922db0ef07e4bb6e60e14a"
SDT_URI[S] = "${WORKDIR}/emb-plus-ve2302-sdt_2024.2_1105_1"

# Set the system device trees
SYSTEM_DTFILE_DEPENDS = "sdt-artifacts"
SYSTEM_DTFILE_DIR = "${RECIPE_SYSROOT}${datadir}/sdt/${MACHINE}"
SYSTEM_DTFILE = "${SYSTEM_DTFILE_DIR}/system-top.dts"

# Load the dynamic machine features
include conf/machine/include/emb-plus-ve2302-sdt/${BB_CURRENT_MC}-features.conf
LIBXIL_CONFIG = "conf/machine/include/emb-plus-ve2302-sdt/${BB_CURRENT_MC}-libxil.conf"

# Versal PDI
PDI_PATH_DEPENDS = "sdt-artifacts"
PDI_PATH_DIR = "${RECIPE_SYSROOT}${datadir}/sdt/${MACHINE}"
PDI_PATH = "${PDI_PATH_DIR}/ve2302_pcie_qdma_base.pdi"

# Update bootbin to use proper device tree
BIF_PARTITION_IMAGE[device-tree] = "${RECIPE_SYSROOT}/boot/devicetree/${@os.path.basename(d.getVar('CONFIG_DTFILE').replace('.dts', '.dtb'))}"

# Remap boot files to ensure the right device tree is listed first
IMAGE_BOOT_FILES =+ "devicetree/${@os.path.basename(d.getVar('CONFIG_DTFILE').replace('.dts', '.dtb'))}"

#### No additional settings should be after the Postamble
#### Postamble
PACKAGE_EXTRA_ARCHS:append = "${@['', ' emb_plus_ve2302_sdt']['emb-plus-ve2302-sdt' != '${MACHINE}']}"
```

## conf/machine/emb-plus-ve2302-xrt.conf
```bitbake
#@TYPE: Machine
#@NAME: emb-plus-ve2302-xrt
#@DESCRIPTION: Machine configuration for the AMD Embedded+ VE2302 board (Versal AI Edge VE2302) running the XRT (Xilinx Runtime) stack: Cortex-A72 Linux plus MicroBlaze PMC/PSM firmware sub-machines.

BBMULTICONFIG += "emb-plus-ve2302-xrt-microblaze-pmc emb-plus-ve2302-xrt-microblaze-psm"

#### Preamble
MACHINEOVERRIDES =. "${@['', 'emb-plus-ve2302-xrt:']['emb-plus-ve2302-xrt' !='${MACHINE}']}"
#### Regular settings follow
TUNEFILE[microblaze-pmc] = "conf/machine/include/emb-plus-ve2302-xrt/microblaze.inc"
TUNEFILE[microblaze-psm] = "conf/machine/include/emb-plus-ve2302-xrt/microblaze.inc"

# Platform Loader and Manager
PLM_DEPENDS = ""
PLM_MCDEPENDS = "mc::emb-plus-ve2302-xrt-microblaze-pmc:plm-firmware:do_deploy"
PLM_DEPLOY_DIR = "${TMPDIR}-emb-plus-ve2302-xrt-microblaze-pmc/deploy/images/${MACHINE}"

# PSM Firmware
PSM_DEPENDS = ""
PSM_MCDEPENDS = "mc::emb-plus-ve2302-xrt-microblaze-psm:psm-firmware:do_deploy"
PSM_FIRMWARE_DEPLOY_DIR = "${TMPDIR}-emb-plus-ve2302-xrt-microblaze-psm/deploy/images/${MACHINE}"

# Set the default (linux) domain device tree
CONFIG_DTFILE_DIR := "${@bb.utils.which(d.getVar('BBPATH'), 'conf/dts/emb-plus-ve2302-xrt')}"
CONFIG_DTFILE ?= "${CONFIG_DTFILE_DIR}/cortexa72-linux.dts"
CONFIG_DTFILE[vardepsexclude] += "CONFIG_DTFILE_DIR"

DTB_FILE_PATH ?= "${RECIPE_SYSROOT}/boot/devicetree/${@os.path.basename(d.getVar('CONFIG_DTFILE').replace('.dts', '.dtb'))}"

# Serial Console Settings
SERIAL_CONSOLES ?= "115200;ttyAMA0"

# Yocto arm-trusted-firmware(TF-A) variables
TFA_CONSOLE ?= "pl011"
TFA_BL33_LOAD ?= "0x8000000"

# Yocto u-boot-xlnx variables

# Set DDR Base address for u-boot-xlnx-scr variables
DDR_BASEADDR ?= "0x0"
SKIP_APPEND_BASEADDR ?= "0"

# Yocto KERNEL Variables
UBOOT_ENTRYPOINT ?= "0x200000"
UBOOT_LOADADDRESS ?= "0x200000"

# Yocto MACHINE_FEATURES Variable
MACHINE_FEATURES += "vdu efi"

# Required generic machine inclusion
require conf/machine/versal-generic.conf

# QEMU Memory Configuration
QB_MEM = "-machine dynamic-mem=on -device amd-ddr-memory,address=0x20108000000,size=0x8000000 -device amd-ddr-memory,address=0x50000000000,size=0x180000000"

# Use the specific boot script
UBOOT_BOOT_SCRIPT:emb-plus-ve2302-xrt:${DISTRO} = "u-boot-xlnx-scr"
# OSPI flash size (128MB)
SPI_IMAGE_SIZE = "0x0800_0000"

# This is an 'SDT' based BSP
XILINX_WITH_ESW = "sdt"

# Original SDT artifacts URL
SDT_URI = "https://edf.amd.com/sswreleases/rel-v2026.1/sdt/2026.1/2026.1_0609_1_06092108/external/emb-plus-ve2302-xrt/emb-plus-ve2302-xrt_2026.1_0605_1_06092108.tar.gz"
SDT_URI[sha256sum] = "c7527a51aab9e0977e010224960bf1e922d256dbed2e4cf0655fe3f21e96e2d3"
SDT_URI[S] = "${WORKDIR}/emb-plus-ve2302-xrt_2026.1_0605_1_06092108"

# Set the system device trees
SYSTEM_DTFILE_DEPENDS = "sdt-artifacts"
SYSTEM_DTFILE_DIR = "${RECIPE_SYSROOT}${datadir}/sdt/${MACHINE}"
SYSTEM_DTFILE = "${SYSTEM_DTFILE_DIR}/system-top.dts"

# Load the dynamic machine features
include conf/machine/include/emb-plus-ve2302-xrt/${BB_CURRENT_MC}-features.conf
LIBXIL_CONFIG = "conf/machine/include/emb-plus-ve2302-xrt/${BB_CURRENT_MC}-libxil.conf"

# PDI variables
PDI_PATH_DEPENDS = "sdt-artifacts"
PDI_PATH_DIR = "${RECIPE_SYSROOT}${datadir}/sdt/${MACHINE}"
PDI_PATH = "${PDI_PATH_DIR}/ve2302_pcie_xdma_base.pdi"

# Primary Bootmode value
DEFAULT_HW_BOOT_MODE = "5"

# Update bootbin to use proper device tree
BIF_PARTITION_IMAGE[device-tree] = "${DTB_FILE_PATH}"

# Remap boot files to ensure the right device tree is listed first
IMAGE_BOOT_FILES =+ "devicetree/${@os.path.basename(d.getVar('CONFIG_DTFILE').replace('.dts', '.dtb'))}"

#### No additional settings should be after the Postamble
#### Postamble
PACKAGE_EXTRA_ARCHS:append = "${@['', ' emb_plus_ve2302_xrt']['emb-plus-ve2302-xrt' != '${MACHINE}']}"
```
